## partikle/Kconfig
```kconfig
# Plug and Play configuration
mainmenu "PaRTiKle Configuration Tool"

choice
	prompt "Architecture"
	default ARCH_X86
config ARCH_X86
	bool "x86 Stand Alone system"
	help
		Choose this to run PaRTiKle on a standard PC or compatible.
config ARCH_ARM
	bool "ARM Stand Alone system"
	help
		Choose this to run PaRTiKle on the qemu-system-arm which emulates a IntegratorCP board.
config ARCH_LINUX
	bool "Regular Linux process"
	help
		Choose this to run PaRTiKle as a standard Linux process.
config ARCH_XTRATUM
	bool "XtratuM domain"
	help
		Choose this to run PaRTiKle over the HAL provided by XtratuM.
config ARCH_LPC
	bool "LPC (arm7) Stand Alone system"
	help
		Choose this to run PaRTiKle on a LPC2000 based system.
endchoice

menu "Devices"
source "core/kernel/port/Kconfig.drv"

# architecture specific devices
if ARCH_X86
source "core/kernel/i386/Kconfig.drv"
endif

if ARCH_ARM
source "core/kernel/arm/Kconfig.drv"
endif

if ARCH_LINUX
source "core/kernel/linux/Kconfig.drv"
endif

if ARCH_XTRATUM
source "core/kernel/xm_i386/Kconfig.drv"
endif
endmenu

# portable section
source "core/kernel/port/Kconfig"

menu "Architecture specific"

# architecture specific devices
if ARCH_X86
source "core/kernel/i386/Kconfig"
endif

if ARCH_ARM
source "core/kernel/arm/Kconfig"
endif

if ARCH_LINUX
source "core/kernel/linux/Kconfig"
endif

if ARCH_XTRATUM
source "core/kernel/xm_i386/Kconfig"
endif
endmenu

# common options
source "core/Kconfig"
```

## partikle/core/Kconfig
```kconfig
# Plug and Play configuration

menu "Core Options"
config KDYNAMIC_MEMORY
	int  "Kernel dynamic memory"
	default 2097152
	help
		Amount of dynamic memory for the kernel (bytes).
		
config UDYNAMIC_MEMORY
	int "User dynamic memory"
	default 1047552
	help
		Amount of dynamic memory for the application (bytes).

config VERBOSE_COMPILE
	bool "Verbose Compiling"
	default n
	help
		Display compilation information while building the PaRTiKle
		system.

		Enable this option only if the compilation of PaRTiKle fails,
		then report the output to the developers.

config DEBUGGING
	bool "Debugging support"
	default n
	help
		If you say Yes, then both, PaRTiKle and applications, will be
		compiled with the "-g" flag enabled. It allows you to debug
		your application with a debugger, like gdb.

config FP_SUPPORT
	bool "Floating Point Support"
	default n
	help
		Enable PaRTiKLe to use the FPU

endmenu

menu "Ulibc Options"

config ULIBC_ERRSTR
	bool "Include error messages for the codes in errno.h" 
	default y
	help
		This option can be useful, while developing and testing code
		and can be disabled for the construction of production code.
		Since error messages increment in 5 kbytes the kernel size.

endmenu

menu "Language Support"

config ADA_SUPPORT
	bool "Enable Ada Support" 
	default n
	select FP_SUPPORT   

config GNAT_PATH
	string "GNAT Path" if ADA_SUPPORT
	default "/opt/gnat2005"
        help
	  This should point to the location of the gnat compiler suite,
	  to the base directory containing the bin/ directory.

config CXX_SUPPORT
	bool "Enable C++ Support" 
	default n

config JAVA_SUPPORT
	bool "Enable Java Support"
	default n

endmenu
```

## partikle/core/kernel/arm/Kconfig
```kconfig
#
# Plug and Play configuration
#

choice
	prompt "ARM Board"
	default BOARD_INTEGRATORCP
	help

config BOARD_INTEGRATORCP
	bool "IntegratorCP"
	help

config BOARD_CERFCUBE255
	bool "CerfCube 255"
	help

endchoice


menu "CPU features"
choice
	prompt "ARM Processor"
	default ARM926E if BOARD_INTEGRATORCP
#	default ARM1026E if BOARD_CERFCUBE255

config ARM926E
	bool "ARM926E"
	help

#config ARM1026E
#	bool "ARM1026E"
#	help

#config XSCALE
#	bool "XSCALE"
#	help

endchoice

config ARMV4
	def_bool y if ARM926E 

#|| ARM1026E

#config ARMV5
#	def_bool y if XSCALE

endmenu
```

## partikle/core/kernel/arm/Kconfig.drv
```kconfig
menu "Drivers"

config DRV_PL011
	bool "UART PL011"
	default y if BOARD_INTEGRATORCP 
	help

config DRV_ICP_PIC
	def_bool y if BOARD_INTEGRATORCP

config DRV_ICP_PIT
        def_bool y if BOARD_INTEGRATORCP

endmenu
```

## partikle/core/kernel/i386/Kconfig
```kconfig
#
# Plug and Play configuration
#

menu "CPU features"
config X86_PAGING
	bool "Enable paging"
	help
		When using paging, PaRTiKle isolates the kernel code from
		the application code easing the detection of programming bugs.
		The main drawback of this option is the incrementation of the
		size of the kernel in several Kbytes.

config FP_SUPPORT
	bool "Floating Point Support"
	default n
	help
		Enable PaRTiKLe to use the FPU

endmenu
```

## partikle/core/kernel/port/Kconfig.drv
```kconfig
config PORT_DEVUART
	depends on ARCH_X86 || ARCH_LINUX || ARCH_XTRATUM
	bool "Enable the serial uart device (i8250 based)"
	help
		When selected provides the following device files
		/dev/uart/{uart%d, uart%dctl, uart%dstatus},
		where "%d" is the correspoding serial port number
		used to send/receive data through the serial line.

config PORT_DEVTRACE
	depends on ARCH_LINUX
	bool "Enable devtrace (runtime execution traces)"
	help
		When selected provides the following device file
		/dev/trace, which accepts the messages: "enable"/"disable"
		to control the logging of syscalls and cpu time
		to a .ktr file which can be viewed with Kiwi.

		See also the exampled provided: users/regressions_tests/devtrace.c.

		NOTE: This can be useful on testing phases
		but is advisable to disable it for the final version.
```

## partikle/core/kernel/xm_i386/Kconfig.drv
```kconfig
config XTRATUM_FIFO
	bool "Enable XtratuM fifos"
	help
		Choose this to use RT fifos (provided by xtratum)
		as a communication mechanism between PaRTiKle and the other domains.

		To use them you need to patch XtratuM to add FIFO support,
		see the file docs/NOTES.fifo which contains a step by step guide to use the XtratuM fifos.

config XTRATUM_SHM
	bool "Enable XtratuM SHM"
	help
		choose this to use SHM (provided by XtrautM)
		as a communication mechanism between PaRTiKle and the other domains.
```
